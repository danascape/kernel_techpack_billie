## Kconfig
```kconfig
menu "Oneplus N10 platform"
	depends on ARCH_LAGOON
config MACH_ONEPLUS_BILLIE
	bool "Oneplus N10"
	depends on ARCH_LAGOON
	help
	  Support for Oneplus N10

source "techpack/billie/coretech/Kconfig"
source "techpack/billie/input/Kconfig"
source "techpack/billie/fs/Kconfig"
source "techpack/billie/kernel/Kconfig"
source "techpack/billie/misc/Kconfig"
#source "techpack/billie/vibrator/Kconfig"
source "techpack/billie/power/Kconfig"
source "techpack/billie/vibrator/Kconfig"
#source "techpack/billie/power/Kconfig"
source "techpack/billie/oneplus_healthinfo/Kconfig"
source "techpack/billie/mm/Kconfig"
source "techpack/billie/opslalib/Kconfig"
#source "techpack/billie/framework/Kconfig"
source "techpack/billie/vl53L1/Kconfig"
source "techpack/billie/op_freezer/Kconfig"
source "techpack/billie/hung_task_enhance/Kconfig"
source "techpack/billie/wt_sys/Kconfig"

endmenu
```

## fs/Kconfig
```kconfig
# oem device deriver
source "techpack/billie/fs/proc/Kconfig"
source "techpack/billie/fs/f2fs/Kconfig"
```

## input/Kconfig
```kconfig
# oem device deriver
source "techpack/billie/input/touchscreen/Kconfig"
source "techpack/billie/input/touchscreen_himax/Kconfig"
source "techpack/billie/input/fingerprint/Kconfig"

config TOUCHPANEL_ONEPLUS
	default n
	bool "Enable/Disable the touchscreen common driver"

config OP_HIMAX
       default n
       bool "Enable/Disable the touchscreen_himax driver"
```

## input/touchscreen/Focal/Kconfig
```kconfig
#source "techpack/billie/input/touchscreen/Focal/FT8006/Kconfig"
source "techpack/billie/input/touchscreen/Focal/ft3518/Kconfig"
```

## input/touchscreen/Goodix/Kconfig
```kconfig
source "techpack/billie/input/touchscreen/Goodix/GT9886/Kconfig"
source "techpack/billie/input/touchscreen/Goodix/GT9897/Kconfig"
```

## input/touchscreen/Kconfig
```kconfig
source "techpack/billie/input/touchscreen/Focal/Kconfig"
source "techpack/billie/input/touchscreen/util_interface/Kconfig"
source "techpack/billie/input/touchscreen/samsung/Kconfig"
source "techpack/billie/input/touchscreen/Goodix/Kconfig"

config TOUCHPANEL_ONEPLUS
	default n
	bool "Enable/Disable the touchscreen common driver"

config OP_TOUCHSCREEN
	default y
	bool "Enable/Disable the touchscreen common driver"
```

## input/touchscreen_himax/Kconfig
```kconfig
	
source "techpack/billie/input/touchscreen_himax/util_interface/Kconfig"
#source "techpack/billie/input/touchscreen/samsung/Kconfig"
source "techpack/billie/input/touchscreen_himax/himax/Kconfig"
#source "techpack/billie/input/touchscreen/Goodix/Kconfig"
```

## net/Kconfig
```kconfig
config SLA
	bool "to monitor netlink traffic"
	default n
	help
	  Realtime netlink traffic monitor.
	  The purpose of this is to monitor the ipv4 packet status and
	  switch between each interface.

	  If unsure, say n.

config SLA_ALGO
	bool "op algo"
	default n
	bool "OnePlus SLA algorithm"
	help
	  Realtime netlink traffic monitor.
	  The purpose of this is to monitor the ipv4 packet status and
	  switch between each interface.

	  If unsure, say n.
```

## power/Kconfig
```kconfig
# oem device driver for charge
#
source "techpack/billie/power/supply/Kconfig"
source "techpack/billie/power/oplus_chg/Kconfig"
```

## power/supply/Kconfig
```kconfig
# oem device driver for charge
#
source "techpack/billie/power/supply/qcom/Kconfig"
source "techpack/billie/power/supply/wlchg/Kconfig"

config OP_POWER_SUPPLY
	default y
	bool "Enable/Disable oneplus power related drivers"
```
